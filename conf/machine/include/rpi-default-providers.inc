## conf/machine/include/rpi-default-providers.inc
```bitbake
# RaspberryPi BSP default providers

PREFERRED_PROVIDER_virtual/kernel ?= "linux-raspberrypi"
PREFERRED_PROVIDER_u-boot ?= "u-boot-rpi"
PREFERRED_PROVIDER_virtual/xserver ?= "xserver-xorg"
PREFERRED_PROVIDER_virtual/egl ?= "userland"
PREFERRED_PROVIDER_virtual/libgles2 ?= "userland"
PREFERRED_PROVIDER_virtual/libgl ?= "mesa-gl"
PREFERRED_PROVIDER_virtual/mesa ?= "mesa-gl"
PREFERRED_PROVIDER_jpeg ?= "jpeg"

# To use a kernel with the VC4 DRM/KMS driver instead, comment the
# virtual kernel, egl, libgles2, libgl and mesa preferred provider
# above and uncomment the following lines.
#
# PREFERRED_PROVIDER_virtual/kernel = "linux-raspberrypi-vc4"
# PREFERRED_PROVIDER_virtual/egl ?= "mesa"
# PREFERRED_PROVIDER_virtual/libgles2 ?= "mesa"
# PREFERRED_PROVIDER_virtual/libgl ?= "mesa"
# PREFERRED_PROVIDER_virtual/mesa ?= "mesa"
```

## conf/machine/include/rpi-default-versions.inc
```bitbake
# RaspberryPi BSP default versions

PREFERRED_VERSION_linux-raspberrypi ?= "4.1.%"
PREFERRED_VERSION_mesa ?= "10.6.%"
PREFERRED_VERSION_libdrm ?= "2.4.61%"
```
